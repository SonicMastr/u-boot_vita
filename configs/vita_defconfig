## configs/vita_defconfig
```kconfig
CONFIG_ARM=y
CONFIG_SYS_ARM_CACHE_CP15=y
# CONFIG_SYS_ARM_MMU is not set
CONFIG_TARGET_VITA=y
CONFIG_VITA_SERIAL=y
CONFIG_TEXT_BASE=0x44000000
CONFIG_SYS_LOAD_ADDR=0x40300000
CONFIG_DEBUG_LL=y
CONFIG_DEBUG_LL_UART_VITA=y
CONFIG_DEBUG_UART_PHYS=0xE2040000
CONFIG_SYS_BOOTM_LEN=0x4000000
CONFIG_DEFAULT_DEVICE_TREE="vita"
CONFIG_CMD_LZMADEC=y
CONFIG_CMD_UNLZ4=y
CONFIG_CMD_UNZIP=y
CONFIG_CMD_DM=y
CONFIG_OF_CONTROL=y
CONFIG_FIRMWARE=y
# CONFIG_CMD_NET is not set
# CONFIG_MMC is not set
# CONFIG_DISPLAY_CPUINFO is not set
# CONFIG_SPECIFY_CONSOLE_INDEX is not set
CONFIG_SPI=y
CONFIG_PANIC_HANG=y
```
